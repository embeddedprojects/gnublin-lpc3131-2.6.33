## linux-2.6.33-lpc313x/arch/arm/Kconfig.rej
```kconfig
--- arch/arm/Kconfig
+++ arch/arm/Kconfig
@@ -728,6 +728,15 @@
 	help
 	  Support for ST-Ericsson's Ux500 architecture
 
+config ARCH_LPC313X
+	bool "NXP LPC313X series"
+	select CPU_ARM926T
+	help
+	  Say Y here for systems based on one of the NXP LPC313x & LPC315x
+	  System on a Chip processors.  These CPUs include an ARM926EJS
+	  core with a wide array of integrated devices for
+	  hand-held and low-power applications.
+
 endchoice
 
 source "arch/arm/mach-aaec2000/Kconfig"
@@ -836,6 +845,8 @@
 
 source "arch/arm/mach-w90x900/Kconfig"
 
+source "arch/arm/mach-lpc313x/Kconfig"
+
 # Definitions to make life easier
 config ARCH_ACORN
 	bool
@@ -1180,7 +1191,7 @@
 		   ARCH_LUBBOCK || MACH_MAINSTONE || ARCH_NETWINDER || \
 		   ARCH_OMAP || ARCH_P720T || ARCH_PXA_IDP || \
 		   ARCH_SA1100 || ARCH_SHARK || ARCH_VERSATILE || \
-		   ARCH_AT91 || ARCH_DAVINCI || \
+		   ARCH_AT91 || ARCH_DAVINCI || ARCH_LPC313X || \
 		   ARCH_KS8695 || MACH_RD88F5182 || ARCH_REALVIEW
 	help
 	  If you say Y here, the LEDs on your machine will be used
@@ -1196,7 +1207,7 @@
 config LEDS_TIMER
 	bool "Timer LED" if (!ARCH_CDB89712 && !ARCH_OMAP) || \
 			    OMAP_OSK_MISTRAL || MACH_OMAP_H2 \
-			    || MACH_OMAP_PERSEUS2
+			    || MACH_OMAP_PERSEUS2 || ARCH_LPC313X
 	depends on LEDS
 	depends on !GENERIC_CLOCKEVENTS
 	default y if ARCH_EBSA110
@@ -1215,7 +1226,7 @@
 	bool "CPU usage LED" if (!ARCH_CDB89712 && !ARCH_EBSA110 && \
 			!ARCH_OMAP) \
 			|| OMAP_OSK_MISTRAL || MACH_OMAP_H2 \
-			|| MACH_OMAP_PERSEUS2
+			|| MACH_OMAP_PERSEUS2 || ARCH_LPC313X
 	depends on LEDS
 	help
 	  If you say Y here, the red LED will be used to give a good real
```

## linux-2.6.33-lpc313x/arch/arm/mach-lpc313x/Kconfig
```kconfig
menu "LPC313x Implementations"
	depends on ARCH_LPC313X

choice
	prompt "LPC313x Platform type"
	default MACH_EA313X

config MACH_EA313X
	bool "ea313x board"
	help
	  Say Y here if you are using the Embedded Artist's EA313x board

config MACH_EA3152
	bool "ea3152 board"
	select LPC3152_AD
	help
	  Say Y here if you are using Embedded Artist's EA3152 board
	  
config MACH_VAL3153
	bool "val3153 board"
	help
	  Say Y here if you are using the NXP val3153 board

config MACH_VAL3154
	bool "val3154 board"
	select LPC3152_AD
	help
	  Say Y here if you are using the NXP val3154 board
	  
endchoice

config LPC3152_AD
	bool

source "kernel/Kconfig.hz"

endmenu



menu "Special settings"
	depends on ARCH_LPC313X


config CS_TO_IO11
	bool "Set CS pin to GPIO11"
	help
		It may be helpfull to change the CS Pin to GPIO11, if you want to use an 14-Pin connector
		on GNUBLIN.
endmenu

#menu "GNUBLIN IRQ INITIALISATION(not supportet yet!)"
#	depends on ARCH_LPC313X

	
#choice 
#	 bool "Choice menu"
	 
#		config IRQ_GPIO_LOW_ACTIVE
#		bool "LOW"
#		config IRQ_GPIO_HIGH_ACTIVE
#	 	bool "HIGH"
#	endchoice
#endmenu
```

## linux-2.6.33-lpc313x/drivers/i2c/busses/Kconfig.rej
```kconfig
--- drivers/i2c/busses/Kconfig
+++ drivers/i2c/busses/Kconfig
@@ -468,7 +468,7 @@
 
 config I2C_PNX
 	tristate "I2C bus support for Philips PNX targets"
-	depends on ARCH_PNX4008
+	depends on ARCH_PNX4008 || ARCH_LPC313X
 	help
 	  This driver supports the Philips IP3204 I2C IP block master and/or
 	  slave controller
```

## linux-2.6.33-lpc313x/drivers/mmc/host/Kconfig.rej
```kconfig
--- drivers/mmc/host/Kconfig
+++ drivers/mmc/host/Kconfig
@@ -4,6 +4,12 @@
 
 comment "MMC/SD/SDIO Host Controller Drivers"
 
+config MMC_LPC313x
+	tristate "NXP LPC313x SD/MMC Card Interface support"
+	default M
+	help
+	  set default module sd/mmc installed for lpc313x
+	  
 config MMC_ARMMMCI
 	tristate "ARM AMBA Multimedia Card Interface support"
 	depends on ARM_AMBA
```

## linux-2.6.33-lpc313x/drivers/mtd/nand/Kconfig.rej
```kconfig
--- drivers/mtd/nand/Kconfig
+++ drivers/mtd/nand/Kconfig
@@ -461,6 +461,12 @@
 	help
 	  Several Renesas SuperH CPU has FLCTL. This option enables support
 	  for NAND Flash using FLCTL. This driver support SH7723.
+	  
+config MTD_NAND_LPC313X
+	tristate "Support for NAND Controller on NXP LPC313x"
+	depends on ARCH_LPC313X
+	help
+	  This enables the NAND flash controller on the LPC313x
 
 config MTD_NAND_DAVINCI
         tristate "Support NAND on DaVinci SoC"
```

## linux-2.6.33-lpc313x/drivers/net/Kconfig.rej
```kconfig
--- drivers/net/Kconfig
+++ drivers/net/Kconfig
@@ -1439,7 +1439,7 @@
 config CS89x0
 	tristate "CS89x0 support"
 	depends on NET_ETHERNET && (ISA || EISA || MACH_IXDP2351 \
-		|| ARCH_IXDP2X01 || ARCH_PNX010X || MACH_MX31ADS)
+		|| ARCH_IXDP2X01 || ARCH_PNX010X || MACH_MX31ADS || MACH_VAL3153)
 	---help---
 	  Support for CS89x0 chipset based Ethernet cards. If you have a
 	  network (Ethernet) card of this type, say Y and read the
@@ -1453,7 +1453,7 @@
 config CS89x0_NONISA_IRQ
 	def_bool y
 	depends on CS89x0 != n
-	depends on MACH_IXDP2351 || ARCH_IXDP2X01 || ARCH_PNX010X || MACH_MX31ADS
+	depends on MACH_IXDP2351 || ARCH_IXDP2X01 || ARCH_PNX010X || MACH_MX31ADS || MACH_VAL3153
 
 config TC35815
 	tristate "TOSHIBA TC35815 Ethernet support"
```

## linux-2.6.33-lpc313x/drivers/serial/Kconfig.rej
```kconfig
--- drivers/serial/Kconfig
+++ drivers/serial/Kconfig
@@ -70,6 +70,12 @@
 
 	  If unsure, say N.
 
+config LPC31XX_SERIAL_DMA_SUPPORT
+	bool "DMA support for the LPC31XX RX/TX functions"
+	depends on SERIAL_8250=y
+	help
+	 Enables DMA support for the UART function
+
 config FIX_EARLYCON_MEM
 	bool
 	depends on X86
```

## linux-2.6.33-lpc313x/drivers/usb/core/Kconfig.rej
```kconfig
--- drivers/usb/core/Kconfig
+++ drivers/usb/core/Kconfig
@@ -107,7 +107,7 @@
 	  If you are unsure about this, say N here.
 
 config USB_OTG
-	bool
+	bool "OTG Support"
 	depends on USB && EXPERIMENTAL
 	select USB_SUSPEND
 	default n
```

## linux-2.6.33-lpc313x/drivers/usb/gadget/Kconfig.rej
```kconfig
--- drivers/usb/gadget/Kconfig
+++ drivers/usb/gadget/Kconfig
@@ -155,12 +155,12 @@
 	select USB_GADGET_SELECTED
 
 config USB_GADGET_FSL_USB2
-	boolean "Freescale Highspeed USB DR Peripheral Controller"
-	depends on FSL_SOC || ARCH_MXC
+	boolean "Freescale/LPC313x Highspeed USB DR Peripheral Controller"
+	depends on FSL_SOC || ARCH_MXC || ARCH_LPC313X
 	select USB_GADGET_DUALSPEED
 	help
-	   Some of Freescale PowerPC processors have a High Speed
-	   Dual-Role(DR) USB controller, which supports device mode.
+	   Some of Freescale PowerPC processors and LPC313x have a High 
+	   Speed Dual-Role(DR) USB controller, which supports device mode.
 
 	   The number of programmable endpoints is different through
 	   SOC revisions.
```

## linux-2.6.33-lpc313x/drivers/usb/host/Kconfig.rej
```kconfig
--- drivers/usb/host/Kconfig
+++ drivers/usb/host/Kconfig
@@ -59,6 +59,21 @@
 	  To compile this driver as a module, choose M here: the
 	  module will be called ehci-hcd.
 
+config USB_EHCI_EHSET
+	bool "Embedded High-speed Host Electrical Test Support (EXPERIMENTAL)"
+	depends on USB_EHCI_HCD && EXPERIMENTAL
+	---help---
+	  This option is only used if you are developing firmware for
+	  an embedded device with a Hi-speed USB Host or OTG port.
+
+	  If you say Y here, software support for the Embedded High-speed
+	  Host Electrical Tests will be added to the EHCI driver. This is
+	  one of the tests performed during High-speed USB Host certification
+	  testing.
+
+	  If you are at all unsure then say N here.
+
+
 config USB_EHCI_ROOT_HUB_TT
 	bool "Root Hub Transaction Translators"
 	depends on USB_EHCI_HCD
@@ -150,6 +165,13 @@
 	  To compile this driver as a module, choose M here: the
 	  module will be called oxu210hp-hcd.
 
+config USB_EHCI_LPC
+	bool "Support for NXP on-chip EHCI USB controller"
+	depends on USB_EHCI_HCD && ARCH_LPC313X
+	select USB_EHCI_ROOT_HUB_TT
+	---help---
+	  Variation of ARC USB block used in some NXP chips.
+
 config USB_ISP116X_HCD
 	tristate "ISP116X HCD support"
 	depends on USB
```

## linux-2.6.33-lpc313x/drivers/watchdog/Kconfig.rej
```kconfig
--- drivers/watchdog/Kconfig
+++ drivers/watchdog/Kconfig
@@ -289,6 +289,15 @@
 	  Say Y here if you want support for the watchdog timer on Avionic
 	  Design Xanthos boards.
 
+config LPC313X_WATCHDOG
+	tristate "NXP LPC313x watchdog"
+	depends on ARCH_LPC313X
+	help
+	  Say Y here if to include support for the watchdog timer
+	  for the NXP's LPC313x uC SoC.
+	  To compile this driver as a module, choose M here: the
+	  module will be called wdt_lpc313x.
+
 # AVR32 Architecture
 
 config AT32AP700X_WDT
```

## linux-2.6.33-lpc313x/sound/soc/Kconfig.rej
```kconfig
--- sound/soc/Kconfig
+++ sound/soc/Kconfig
@@ -36,6 +36,7 @@
 source "sound/soc/s6000/Kconfig"
 source "sound/soc/sh/Kconfig"
 source "sound/soc/txx9/Kconfig"
+source "sound/soc/lpc313x/Kconfig"
 
 # Supported codecs
 source "sound/soc/codecs/Kconfig"
```

## linux-2.6.33-lpc313x/sound/soc/codecs/Kconfig.rej
```kconfig
--- sound/soc/codecs/Kconfig
+++ sound/soc/codecs/Kconfig
@@ -35,6 +35,7 @@
 	select SND_SOC_TWL4030 if TWL4030_CORE
 	select SND_SOC_UDA134X
 	select SND_SOC_UDA1380 if I2C
+	select SND_SOC_LPC315X_CODEC if I2C
 	select SND_SOC_WM8350 if MFD_WM8350
 	select SND_SOC_WM8400 if MFD_WM8400
 	select SND_SOC_WM8510 if SND_SOC_I2C_AND_SPI
@@ -158,6 +159,9 @@
 config SND_SOC_UDA134X
        tristate
 
+config SND_SOC_LPC315X_CODEC
+       tristate
+
 config SND_SOC_UDA1380
         tristate
 
```
